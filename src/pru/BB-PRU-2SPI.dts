/* Device Tree Overlay for enabling the pins that are used in the Chapter 13
* additional material example on High-Speed Analog to Digital Conversion (ADC) 
* using the PRU-ICSS. This overlay is based on the BB-PRU-01 overlay
* Written by Derek Molloy for the book "Exploring BeagleBone: Tools and 
* Techniques for Building with Embedded Linux" by John Wiley & Sons, 2014
* ISBN 9781118935125. Please see the file README.md in the repository root 
* directory for copyright and GNU GPLv3 license information.
*/

/dts-v1/;
/plugin/;

/ {
   compatible = "ti,beaglebone", "ti,beaglebone-black";
   part-number = "bb_pru_2spi";

   exclusive-use =
          "pru0", 
          "P8.11", "P8.12", "P9.27", "P9.30", "P8.45",
          "pr1_pru0_pru_r30_15", "pr1_pru0_pru_r30_14", "pr1_pru0_pru_r30_5", "pr1_pru0_pru_r30_2", "pr1_pru0_pru_r30_0";

   fragment@0 {
      target = <&am33xx_pinmux>;
      __overlay__ {
         pru_pru_pins: pinmux_pru_pru_pins {   // The PRU pin modes
            pinctrl-single,pins = <
               0x034 0x16 // P8_11 pruout
               0x030 0x16 // P8_12 pruout
               0x1a4 0x35 // P9_27 pruin
               0x198 0x16 // P9_30 pruout
               0x0a0 0x15 // P8_45 pruout
            >;
         };
      };
   };

   fragment@1 {         // Enable the PRUSS
      target = <&pruss>;
      __overlay__ {
         status = "okay";
         pinctrl-names = "default";
         pinctrl-0 = <&pru_pru_pins>;
      };
   };
};
